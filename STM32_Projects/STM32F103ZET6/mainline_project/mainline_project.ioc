# file: mainline_project.ioc
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Mcu.Family=STM32F1
Mcu.Name=STM32F103Z(C-D-E)Tx
Mcu.Package=LQFP144
NVIC.PriorityGroup=NVIC_PRIORITYGROUP_4
OSC_IN.Mode=HSE-External-Oscillator
OSC_IN.Signal=RCC_OSC_IN
OSC_OUT.Mode=HSE-External-Oscillator
OSC_OUT.Signal=RCC_OSC_OUT
PA13.Mode=Serial_Wire
PA13.Signal=SYS_JTMS-SWDIO
PA14.Mode=Serial_Wire
PA14.Signal=SYS_JTCK-SWCLK
PC14-OSC32_IN.Mode=LSE-External-Oscillator
PC14-OSC32_IN.Signal=RCC_OSC32_IN
PC15-OSC32_OUT.Mode=LSE-External-Oscillator
PC15-OSC32_OUT.Signal=RCC_OSC32_OUT
ProjectManager.HeapSize=0x200
ProjectManager.StackSize=0x400
ProjectManager.TargetToolchain=MDK-ARM V5.32
RCC.AHBFreq_Value=72000000
RCC.APB1CLKDivider=RCC_HCLK_DIV2
RCC.APB1Freq_Value=36000000
RCC.APB1TimFreq_Value=72000000
RCC.APB2Freq_Value=72000000
RCC.APB2TimFreq_Value=72000000
RCC.HCLKFreq_Value=72000000
RCC.PLLMUL=RCC_PLL_MUL9
RCC.PLLSourceVirtual=RCC_PLLSOURCE_HSE
RCC.SYSCLKFreq_VALUE=72000000
RCC.SYSCLKSource=RCC_SYSCLKSOURCE_PLLCLK
RCC.USBFreq_Value=72000000
board=custom

// file: Src/main.c
/* USER CODE BEGIN Header */
/**
  ******************************************************************************
  * @file           : main.c
  * @brief          : Main program body
  ******************************************************************************
  * @attention
  *
  * Copyright (c) 2023 STMicroelectronics.
  * All rights reserved.
  *
  * This software is licensed under terms that can be found in the LICENSE file
  * in the root directory of this software component.
  * If no LICENSE file comes with this software, it is provided AS-IS.
  *
  ******************************************************************************
  */
/* USER CODE END Header */
#include "main.h"
#include "gpio.h"

/* USER CODE BEGIN Includes */
#ifdef LED_BREATH_TEST
  #include "led.h"
  #include "pwm.h"
#endif /*LED_BREATH_TEST*/

#ifdef UART_TEST
  #include "uart.h"
#endif /*UART_TEST*/

#ifdef IIC_OLED_TEST
  #include "iic.h"
  #include "oled.h"
#endif /*IIC_OLED_TEST*/

#ifdef KEY_TEST
  #include "key.h"
  #include "btim.h"
  #include "led.h"
#endif /*KEY_TEST*/

#ifdef RELAY_TEST
  #include "relay.h"
#endif /*RELAY_TEST*/

#ifdef MOTOR_TEST
#include "motor.h"
#include "uart.h"
#include "encoder.h"
#endif /*MOTOR_TEST*/
/* USER CODE END Includes */

void SystemClock_Config(void);

int main(void)
{

  /* MCU Configuration--------------------------------------------------------*/

  /* Reset of all peripherals, Initializes the Flash interface and the Systick. */
  HAL_Init();

  /* Configure the system clock */
  SystemClock_Config();

  /* Initialize all configured peripherals */
  MX_GPIO_Init();
  /* USER CODE BEGIN 2 */

  #ifdef UART_TEST
    uart_debug_init();
  #endif /*UART_TEST*/

  #ifdef IIC_OLED_TEST
    OLED_Init();
  #endif /*IIC_OLED_TEST*/

  #ifdef RELAY_TEST
    Relay_Init();
  #endif /*RELAY_TEST*/

  #ifdef KEY_TEST
    uint32_t duty = 0;
    Breath_LED_Direction breath_dir = Breath_Positive;
    led_init();
    key_init();
    TIM6_init(1 - 1 , SystemCoreClock / 1000 - 1);
  #endif /*KEY_TEST*/

  #ifdef LED_BREATH_TEST
    uint32_t duty = 0;
    Breath_LED_Direction breath_dir = Breath_Positive;
    led_init();
    breath_led_init();
  #endif /*LED_BREATH_TEST*/

  #ifdef MOTOR_TEST
    bcd_motor_init(90);   /*直流无刷电机驱动初始化*/
    bcd_encoder_init();   /*编码器初始化——测速*/
    uart_debug_init(115200);  /*USART1初始化*/
	  printf("Hello World\r\n");
  #endif /*MOTOR_TEST*/

  /* USER CODE END 2 */

  /* Infinite loop */

  /* USER CODE BEGIN WHILE */
  //    while (1)
  // {
  //   /* USER CODE END WHILE */
  //    static uint32_t count = 0;
  //    printf("%d.motor speed is: %f rpm.\r\n", ++count, bcd_motor_init_struct.speed);
  //    HAL_Delay(2000);
  //   /* USER CODE BEGIN 3 */
  // }
  /* USER CODE END 3 */
#ifdef UART_TEST

    if (uart_debug_rx_flag == SET)
    {
      uart_debug_rx_flag = RESET;
      printf("character:\r\n");
      HAL_UART_Transmit(&uart_debug_handle, uart_debug_rx_buffer, 1, 1000);
      while (__HAL_UART_GET_FLAG(&uart_debug_handle, UART_FLAG_TC) != SET);
      printf("\r\n");
    }

#endif /*UART_TEST*/

#ifdef RELAY_TEST

        // 打开继电器
        Relay_On();
        HAL_Delay(1000); // 延时1秒

        // 关闭继电器
        Relay_Off();
        HAL_Delay(1000); // 延时1秒

#endif /*RELAY_TEST*/

#ifdef KEY_TEST
   switch(key_scan())
    {
      case KEY0_PRESSED_SHORT: // 短按KEY0开启LED呼吸灯
      breath_led_brightness(&breath_dir, &duty);
      HAL_Delay(5);
      break;

      case KEY1_PRESSED_SHORT:
      led_init();
      break;

      case KEY_UP_PRESSED_SHORT:
      led_init();
      break;

      case KEY0_PRESSED_LONG: // 长按KEY0关闭LED呼吸灯
      led_init();
      break;

      case KEY1_PRESSED_LONG:
      led_init();
      break;

      case KEY_UP_PRESSED_LONG:
      led_init();
      break;
    }
#endif /*KEY_TEST*/

#ifdef LED_BREATH_TEST
  breath_led_brightness(&breath_dir, &duty);
  HAL_Delay(5);
#endif /*LED_BREATH_TEST*/

#ifdef MOTOR_TEST
  // printf("motor speed is: %f rpm.\r\n", bcd_motor_init_struct.speed);
  // HAL_Delay(1000);
    static uint32_t count = 0;
    printf("%d.motor speed is: %f rpm.\r\n", ++count, bcd_motor_init_struct.speed);
    HAL_Delay(2000);
#endif /*MOTOR_TEST*/

#ifdef IIC_OLED_TEST
#endif /*IIC_OLED_TEST*/

}
    /* USER CODE END WHILE */

void SystemClock_Config(void)
{
  RCC_OscInitTypeDef RCC_OscInitStruct = {0};
  RCC_ClkInitTypeDef RCC_ClkInitStruct = {0};

  /** Initializes the RCC Oscillators according to the specified parameters
  * in the RCC_OscInitTypeDef structure.
  */
  RCC_OscInitStruct.OscillatorType = RCC_OSCILLATORTYPE_HSE;
  RCC_OscInitStruct.HSEState = RCC_HSE_ON;
  RCC_OscInitStruct.HSEPredivValue = RCC_HSE_PREDIV_DIV1;
  RCC_OscInitStruct.HSIState = RCC_HSI_ON;
  RCC_OscInitStruct.PLL.PLLState = RCC_PLL_ON;
  RCC_OscInitStruct.PLL.PLLSource = RCC_PLLSOURCE_HSE;
  RCC_OscInitStruct.PLL.PLLMUL = RCC_PLL_MUL9;
  if (HAL_RCC_OscConfig(&RCC_OscInitStruct) != HAL_OK)
  {
    Error_Handler();
  }

  /** Initializes the CPU, AHB and APB buses clocks
  */
  RCC_ClkInitStruct.ClockType = RCC_CLOCKTYPE_HCLK|RCC_CLOCKTYPE_SYSCLK
                              |RCC_CLOCKTYPE_PCLK1|RCC_CLOCKTYPE_PCLK2;
  RCC_ClkInitStruct.SYSCLKSource = RCC_SYSCLKSOURCE_PLLCLK;
  RCC_ClkInitStruct.AHBCLKDivider = RCC_SYSCLK_DIV1;
  RCC_ClkInitStruct.APB1CLKDivider = RCC_HCLK_DIV2;
  RCC_ClkInitStruct.APB2CLKDivider = RCC_HCLK_DIV1;

  if (HAL_RCC_ClockConfig(&RCC_ClkInitStruct, FLASH_LATENCY_2) != HAL_OK)
  {
    Error_Handler();
  }
}

void Error_Handler(void)
{
  __disable_irq();
  while (1)
  {
  }
}
